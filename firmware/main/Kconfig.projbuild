## firmware/main/Kconfig.projbuild
```kconfig
menu "EVB Relay"

config EVB_RELAY_DEFAULT_HOSTNAME
    string "Default device hostname"
    default "esp32-evb-relay"
    help
        Hostname announced by the firmware until runtime configuration
        overrides it.

config EVB_RELAY_DEFAULT_POLL_INTERVAL_MS
    int "Default MOD-IO polling interval (ms)"
    range 50 10000
    default 100
    help
        Poll interval used by the input monitor until runtime configuration
        is stored in NVS.

endmenu
```

## firmware/sdkconfig.defaults
```kconfig
CONFIG_ESPTOOLPY_NO_STUB=y
CONFIG_ESPTOOLPY_FLASHSIZE_4MB=y
CONFIG_PARTITION_TABLE_CUSTOM=y
CONFIG_PARTITION_TABLE_CUSTOM_FILENAME="partitions.csv"
CONFIG_BOOTLOADER_APP_ROLLBACK_ENABLE=y
CONFIG_ESP_TASK_WDT_EN=y
CONFIG_ESP_TASK_WDT_INIT=y
CONFIG_ESP_TASK_WDT_TIMEOUT_S=10
CONFIG_ETH_USE_ESP32_EMAC=y
```

## firmware/test_app/sdkconfig.defaults
```kconfig
CONFIG_IDF_TARGET="esp32"
CONFIG_ESPTOOLPY_FLASHSIZE_4MB=y
CONFIG_BOOTLOADER_APP_ROLLBACK_ENABLE=y
CONFIG_ESP_CONSOLE_UART_DEFAULT=y
CONFIG_ESP_CONSOLE_UART_BAUDRATE=115200
CONFIG_PARTITION_TABLE_TWO_OTA=y
CONFIG_UNITY_ENABLE_IDF_TEST_RUNNER=y
CONFIG_ESP_TASK_WDT_EN=n
```
